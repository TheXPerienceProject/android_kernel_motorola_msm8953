## arch/arm/hotplug/Kconfig
```kconfig
config ALESSA_PLUG
	bool "Enable plugging down/up of cores using LCD_Notify"
	help
	  This driver uses lcd notify to take down the cpu cores
	  on a quad core device.
	  Later this maybe be a reemplace of hotplug.
```

## drivers/staging/prima/Kconfig
```kconfig
comment "Qualcomm Atheros Prima WLAN module"

config PRIMA_WLAN

	tristate "Qualcomm Atheros Prima WLAN module"
	default n
	help
	Add support for the Qualcomm Atheros Prima WLAN module

config PRONTO_WLAN

	tristate "Qualcomm Atheros Pronto WLAN module"
	default n
	help
	Add support for the Qualcomm Atheros Pronto WLAN module


#	depends on WLAN
#	depends on CFG80211
#        depends on WCNSS_CORE

if PRIMA_WLAN != n || PRONTO_WLAN != n

config PRIMA_WLAN_BTAMP
	bool "Enable the Prima WLAN BT-AMP feature"
	default n

config PRIMA_WLAN_LFR
	bool "Enable the Prima WLAN Legacy Fast Roaming feature"
	default n

config PRIMA_WLAN_OKC
	bool "Enable the Prima WLAN Opportunistic Key Caching feature"
	default n

config PRIMA_WLAN_11AC_HIGH_TP
	bool "Enable the Prima WLAN 802.11ac High Throughput option (depends upon kernel support)"
	default n

config WLAN_FEATURE_11W
	bool "Enable the WLAN 802.11w Protected Management Frames feature"
	default n

config QCOM_TDLS
	bool "Enable TDLS feature"
	default n

config QCOM_VOWIFI_11R
	bool "Enable Fast Transition (11r) feature"
	default n

config ENABLE_LINUX_REG
	bool "Enable linux regulatory feature"
	default n

config WLAN_OFFLOAD_PACKETS
	bool "Enable offload packets feature"
	default n

# WLAN_WHITE_LIST - WLAN Radiated Power Test
# For user software build, wlan driver needs to allow the factory
# commnds only for Tx_opcode and NART commands based off 12M doc
# commans whitelisted are :
# set RF channel
# set internal configuration
# enable scpc mode
# set data rate preamble frame number spacinf and playlod
# set Tx Power
# turn on Tx
# turn off Tx
ifeq ($(TARGET_BUILD_VARIANT),user)
CDEFINES += -DWLAN_WHITE_LIST
endif

endif # PRIMA_WLAN || PRONTO_WLAN
```
